## boards/adafruit/feather_rp2040_adalogger/Kconfig.adafruit_feather_rp2040_adalogger
```kconfig
# Copyright (c) 2022 Kelly Lord
# SPDX-License-Identifier: Apache-2.0

config BOARD_ADAFRUIT_FEATHER_RP2040_ADALOGGER
	select SOC_RP2040
```

## boards/adafruit/feather_rp2040_adalogger/board.yml
```yaml
board:
  name: adafruit_feather_rp2040_adalogger
  vendor: adafruit
  socs:
  - name: rp2040
```
